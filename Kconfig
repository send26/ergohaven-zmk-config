## Kconfig
```kconfig
config ZMK_LAYER_REPORT
    bool "Send active layer to host via Raw HID"
    depends on RAW_HID
    default y

if ZMK_LAYER_REPORT

config ZMK_LAYER_REPORT_DEBOUNCE_MS
    int "Debounce time for layer reports in ms"
    default 30

endif
```

## config/west.yml
```yaml
manifest:
  remotes:
    - name: ergohaven
      url-base: https://github.com/ergohaven
    - name: zzeneg
      url-base: https://github.com/zzeneg
    - name: urob
      url-base: https://github.com/urob
  projects:
    - name: ergohaven-zmk
      remote: ergohaven
      revision: main
      import: config/west.yml
    - name: zmk-raw-hid
      remote: zzeneg
      revision: main
  self:
    path: config
```

## dts/bindings/behaviors/zmk,behavior-er-lang.yaml
```yaml
# Copyright (c) 2026
# SPDX-License-Identifier: MIT

description: |
  E+R language chord. In Horizon, hold left Alt and left Shift together.
  Otherwise toggle the firmware English/Russian layer.

compatible: "zmk,behavior-er-lang"

include: zero_param.yaml
```

## dts/bindings/behaviors/zmk,behavior-host-key.yaml
```yaml
# Copyright (c) 2026
# SPDX-License-Identifier: MIT

description: US scancode used by the en macro. Sends nothing when the preceding host layout ACK timed out.

compatible: "zmk,behavior-host-key"

include: one_param.yaml
```

## dts/bindings/behaviors/zmk,behavior-host-layout.yaml
```yaml
# Copyright (c) 2026
# SPDX-License-Identifier: MIT

description: Ask the Mac host to select ABC (0) or Russian (1) via Raw HID 0xAE, then wait for ACK 0xAF. No keycodes.

compatible: "zmk,behavior-host-layout"

include: one_param.yaml
```

## dts/bindings/behaviors/zmk,behavior-sym-glyph.yaml
```yaml
# Copyright (c) 2026
# SPDX-License-Identifier: MIT

description: |
  One symbol glyph. Horizon (Raw HID 0xB0) sends left Alt plus numpad digits.
  Mac Russian asks the host for one Unicode character (0xB1 / ACK 0xB2).
  Mac English sends the US scancode.

compatible: "zmk,behavior-sym-glyph"

include: one_param.yaml
```
