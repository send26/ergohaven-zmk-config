/ {
    behaviors {
        host_layout: host_layout {
            compatible = "zmk,behavior-host-layout";
            #binding-cells = <1>;
            display-name = "Host Layout";
        };
        host_key: host_key {
            compatible = "zmk,behavior-host-key";
            #binding-cells = <1>;
            display-name = "Host Key";
        };
    };
};
